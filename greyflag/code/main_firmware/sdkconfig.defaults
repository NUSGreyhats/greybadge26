## greyflag/code/thread_test/failed stuff/badge_firmware/sdkconfig.defaults
```kconfig
CONFIG_OPENTHREAD_MTD=y
CONFIG_OPENTHREAD_JOINER=y
CONFIG_OPENTHREAD_CLI=n
CONFIG_OPENTHREAD_CONSOLE_ENABLE=n
CONFIG_MBEDTLS_SSL_PROTO_DTLS=y
CONFIG_MBEDTLS_ECJPAKE_C=y
CONFIG_MBEDTLS_KEY_EXCHANGE_ECJPAKE=y
```

## greyflag/code/thread_test/ot_organiser_broadcaster/sdkconfig.defaults
```kconfig
CONFIG_IDF_TARGET="esp32c6"
CONFIG_IEEE802154_ENABLED=y
CONFIG_OPENTHREAD_ENABLED=n
CONFIG_MBEDTLS_CCM_C=y
CONFIG_MBEDTLS_SHA256_C=y
CONFIG_MBEDTLS_MD_C=y
CONFIG_LOG_DEFAULT_LEVEL_INFO=y
```

## greyflag/code/thread_test/sniffer_firmware/sdkconfig.defaults
```kconfig
CONFIG_IEEE802154_ENABLED=y
CONFIG_OPENTHREAD_ENABLED=n
CONFIG_LOG_DEFAULT_LEVEL_WARN=y
```
